## CMakeLists.txt
```
# SPDX-License-Identifier: Apache-2.0

cmake_minimum_required(VERSION 3.20.0)

find_package(Zephyr REQUIRED HINTS $ENV{ZEPHYR_BASE})
project(hello_world)

target_sources(app PRIVATE
	src/main.c
	src/heap_selftest.c
)
```

## prj.conf
```kconfig
# ==========================================
# 1. 基础配置 (你的版本 4.3.0 兼容)
# ==========================================
CONFIG_DEBUG=y
CONFIG_ASSERT=y
CONFIG_LOG=y
CONFIG_LOG_DEFAULT_LEVEL=2
CONFIG_HEAP_MEM_POOL_SIZE=65536
CONFIG_MAIN_STACK_SIZE=4096

# ==========================================
# 2. 内核功能开启 (这些在 4.3.0 中依然有效)
# ==========================================
CONFIG_POLL=y
CONFIG_EVENTS=y
CONFIG_DYNAMIC_INTERRUPTS=y
CONFIG_THREAD_MONITOR=y
CONFIG_THREAD_NAME=y
CONFIG_THREAD_CUSTOM_DATA=y
CONFIG_THREAD_STACK_INFO=y

# 移除 CONFIG_PIPES=y (4.x 已移除)
# 移除 CONFIG_MBOX=y (如果报警告也请移除)

# ==========================================
# 3. 运行环境配置
# ==========================================
CONFIG_USERSPACE=n
CONFIG_FPU=n
CONFIG_CBPRINTF_FP_SUPPORT=y

CONFIG_IDLE_STACK_SIZE=2048

# 增加中断栈 (防止 printk 在中断中溢出)
CONFIG_ISR_STACK_SIZE=4096





CONFIG_ASSERT_LEVEL=2

# 关掉之前的堆检查，防止干扰，我们靠 Assert 抓逻辑错误

CONFIG_SYS_HEAP_VALIDATE=y

CONFIG_SYS_HEAP_INFO=y

# 开启硬件 MPU 栈保护：如果栈溢出，会立刻报 Stack Fail，而不是 PC=0
# CONFIG_HW_STACK_PROTECTION=y
# CONFIG_STACK_SENTINEL=n

# 调大主栈：给 Fuzz 留出足够的呼吸空间
# CONFIG_MAIN_STACK_SIZE=4096

# 调试与符号保留

# ==========================================
# 4. 最小诊断增强（定位内存/栈破坏）
# ==========================================

# ARM Cortex-M fault 信息打印等级（0=关，1=简略，2=详细）
CONFIG_FAULT_DUMP=2

# 初始化线程栈内容（便于更早暴露未初始化/越界类问题；也给栈分析提供基础）
CONFIG_INIT_STACKS=y

# 栈保护（Cortex-M3 无 SPLIM，通常走 MPU stack guard 路线）
# 注意：若开启了 MPU_STACK_GUARD，就不能再启用 STACK_SENTINEL（两者互斥）
CONFIG_ARM_MPU=y
# CONFIG_MPU_STACK_GUARD=y

CONFIG_STACK_SENTINEL=y 

CONFIG_STACK_CANARIES_STRONG=y

# === 实验配置：大栈 + 无保护 ===
CONFIG_HW_STACK_PROTECTION=n  # 关掉保护
# CONFIG_STACK_SENTINEL=n       # 关掉哨兵

# 保持巨大的栈
CONFIG_ISR_STACK_SIZE=4096
# CONFIG_MAIN_STACK_SIZE=16384
# CONFIG_IDLE_STACK_SIZE=8192
```

## overlay_noassert.conf
```kconfig
# Disable assertions to observe behavior in "release-like" configuration
CONFIG_ASSERT=n
CONFIG_ASSERT_LEVEL=0

# Keep heap validation enabled so we can detect silent corruption
CONFIG_SYS_HEAP_VALIDATE=y
```

## src/11111.c
```c
#include <stdio.h>
#include <string.h>

#ifdef TARGET_CUSTOM_INSN
#include "lqemu.h"
#endif

#ifndef TARGET_CUSTOM_INSN
int __attribute__((noinline)) BREAKPOINT() {
    for (;;) {}
}
#endif

// 除零错误漏洞函数
void divide_by_zero_vulnerability(int divisor) {
    printf("Attempting division: 100 / %d\n", divisor);
    
    // 直接进行除法运算，如果除数为0就会触发错误
    int result = 100 / divisor;
    
    printf("Division result: %d\n", result);
}

int LLVMFuzzerTestOneInput(unsigned int *Data, unsigned int Size) {
#ifdef TARGET_CUSTOM_INSN
    libafl_qemu_start_phys((void *)Data, Size);
#endif

    /* 根据输入数据判断是否触发除零错误 */
    if (Size > 0) {
        int divisor = (int)Data[0];
        
        // 如果输入的第一个值是0，就触发除零错误
        if (divisor == 0) {
            printf("Triggering divide-by-zero vulnerability\n");
            divide_by_zero_vulnerability(divisor);
        } else {
            printf("Safe division with divisor: %d\n", divisor);
            int result = 100 / divisor;
            printf("Result: %d\n", result);
        }
    }

    printf("Hello World!\n");

#ifdef TARGET_CUSTOM_INSN
    libafl_qemu_end(LIBAFL_QEMU_END_OK);
#else
    return BREAKPOINT();
#endif
}

// 单个fuzz输入：0会触发除零错误，其他值安全
unsigned int FUZZ_INPUT[] = {0};

int main(void) {
    LLVMFuzzerTestOneInput(FUZZ_INPUT, 1);
    return 0;
}
```

## src/heap_selftest.c
```c
#include <zephyr/kernel.h>
#include <zephyr/sys/printk.h>
#include <zephyr/sys/util.h>
#include <zephyr/sys/sys_heap.h>
#include <string.h>
#include <stdint.h>

/*
 * Dynamic self-tests for Zephyr sys_heap / k_heap.
 *
 * Build/run selftest-only firmware:
 *   west build -b mps2/an385 -p always -- -DCMAKE_C_FLAGS=-DHEAP_SELFTEST_ONLY
 *
 * Optional (will intentionally crash on ASSERT-enabled builds):
 *   -DCMAKE_C_FLAGS='-DHEAP_SELFTEST_ONLY -DHEAP_SELFTEST_MISUSE'
 */

extern int BREAKPOINT(void);

#define ST_HEAP_SIZE 8192
static uint8_t st_mem[ST_HEAP_SIZE] __aligned(64);
static struct k_heap st_kheap;

#ifdef HEAP_SELFTEST_MISUSE
/*
 * Misuse tests may corrupt arbitrary memory when ASSERT is disabled.
 * Place a sentinel region near our heap buffers to make silent scribbles
 * more observable.
 */
static uint8_t st_mem2[ST_HEAP_SIZE] __aligned(64);
static struct k_heap st_kheap2;

static uint32_t st_sentinel[2048];

static volatile uint32_t st_last_round;
static volatile uint32_t st_last_sz;
static volatile uint32_t st_last_off;
static volatile uint32_t st_last_mode;

static void st_sentinel_init(void)
{
	for (size_t i = 0; i < ARRAY_SIZE(st_sentinel); i++) {
		st_sentinel[i] = 0xA5A50000u ^ (uint32_t)i;
	}
}

static bool st_sentinel_ok(void)
{
	for (size_t i = 0; i < ARRAY_SIZE(st_sentinel); i++) {
		uint32_t exp = 0xA5A50000u ^ (uint32_t)i;
		if (st_sentinel[i] != exp) {
			printk("[SELFTEST_MISUSE] sentinel corrupted at idx=%u val=0x%08x exp=0x%08x\n",
			       (unsigned)i, st_sentinel[i], exp);
			return false;
		}
	}
	return true;
}

static void st_heap2_stress(void)
{
	/* Light stress to surface latent corruption */
	void *tmp[32] = {0};
	for (int i = 0; i < 32; i++) {
		tmp[i] = k_heap_alloc(&st_kheap2, 24 + (i % 7), K_NO_WAIT);
		if (tmp[i]) {
			memset(tmp[i], 0x5A, 24 + (i % 7));
		}
	}
	for (int i = 0; i < 32; i++) {
		k_heap_free(&st_kheap2, tmp[i]);
	}
}

static uint32_t st_prng_state = 0xC001D00Du;

static inline uint32_t st_prng_next(void)
{
	/* xorshift32 */
	uint32_t x = st_prng_state;
	x ^= x << 13;
	x ^= x >> 17;
	x ^= x << 5;
	st_prng_state = x;
	return x;
}
#endif

static void st_fail(const char *msg)
{
	printk("[SELFTEST_FAIL] %s\n", msg);
	__builtin_trap();
}

static void st_expect(bool ok, const char *msg)
{
	if (!ok) {
		st_fail(msg);
	}
}

static void st_validate_kheap(const char *where)
{
	bool ok = sys_heap_validate(&st_kheap.heap);
	if (!ok) {
		printk("[SELFTEST] validate failed at: %s\n", where);
		st_fail("sys_heap_validate");
	}
}

static void st_basic_alloc_free(void)
{
	k_heap_init(&st_kheap, st_mem, sizeof(st_mem));
	st_validate_kheap("basic:init");

	void *p1 = k_heap_alloc(&st_kheap, 1, K_NO_WAIT);
	st_expect(p1 != NULL, "alloc(1) returned NULL");
	memset(p1, 0xA5, 1);
	st_validate_kheap("basic:after alloc(1)");

	void *p2 = k_heap_alloc(&st_kheap, 128, K_NO_WAIT);
	st_expect(p2 != NULL, "alloc(128) returned NULL");
	memset(p2, 0x5A, 128);
	st_validate_kheap("basic:after alloc(128)");

	k_heap_free(&st_kheap, p1);
	st_validate_kheap("basic:after free(p1)");

	k_heap_free(&st_kheap, p2);
	st_validate_kheap("basic:after free(p2)");

	/* ISO C semantics */
	k_heap_free(&st_kheap, NULL);
	st_validate_kheap("basic:after free(NULL)");
}

static void st_realloc_semantics(void)
{
	k_heap_init(&st_kheap, st_mem, sizeof(st_mem));
	st_validate_kheap("realloc:init");

	uint8_t *p = k_heap_alloc(&st_kheap, 64, K_NO_WAIT);
	st_expect(p != NULL, "alloc(64) returned NULL");
	for (size_t i = 0; i < 64; i++) {
		p[i] = (uint8_t)i;
	}
	st_validate_kheap("realloc:after alloc");

	/* Grow */
	uint8_t *p2 = k_heap_realloc(&st_kheap, p, 256, K_NO_WAIT);
	st_expect(p2 != NULL, "realloc grow returned NULL");
	for (size_t i = 0; i < 64; i++) {
		if (p2[i] != (uint8_t)i) {
			st_fail("realloc grow data mismatch");
		}
	}
	st_validate_kheap("realloc:after grow");

	/* Shrink */
	uint8_t *p3 = k_heap_realloc(&st_kheap, p2, 32, K_NO_WAIT);
	st_expect(p3 != NULL, "realloc shrink returned NULL");
	for (size_t i = 0; i < 32; i++) {
		if (p3[i] != (uint8_t)i) {
			st_fail("realloc shrink data mismatch");
		}
	}
	st_validate_kheap("realloc:after shrink");

	/* Special cases */
	void *p4 = k_heap_realloc(&st_kheap, NULL, 16, K_NO_WAIT);
	st_expect(p4 != NULL, "realloc(NULL,16) returned NULL");
	st_validate_kheap("realloc:after realloc(NULL,n)");

	void *p5 = k_heap_realloc(&st_kheap, p4, 0, K_NO_WAIT);
	st_expect(p5 == NULL, "realloc(ptr,0) must return NULL");
	st_validate_kheap("realloc:after realloc(ptr,0)");

	k_heap_free(&st_kheap, p3);
	st_validate_kheap("realloc:after final free");
}

static void st_aligned_alloc(void)
{
	k_heap_init(&st_kheap, st_mem, sizeof(st_mem));
	st_validate_kheap("align:init");

	static const size_t aligns[] = { 0, 4, 8, 16, 32, 64 };

	for (size_t ai = 0; ai < ARRAY_SIZE(aligns); ai++) {
		size_t align = aligns[ai];
		for (size_t sz = 1; sz <= 256; sz += 17) {
			void *p = k_heap_aligned_alloc(&st_kheap, align, sz, K_NO_WAIT);
			st_expect(p != NULL, "aligned_alloc returned NULL");
			if (align != 0) {
				st_expect(((uintptr_t)p % align) == 0, "alignment not satisfied");
			}
			memset(p, 0xCC, sz);
			st_validate_kheap("align:after alloc");
			k_heap_free(&st_kheap, p);
			st_validate_kheap("align:after free");
		}
	}
}

static void st_extreme_sizes(void)
{
	k_heap_init(&st_kheap, st_mem, sizeof(st_mem));
	st_validate_kheap("extreme:init");

	void *p0 = k_heap_alloc(&st_kheap, 0, K_NO_WAIT);
	st_expect(p0 == NULL, "alloc(0) must return NULL");
	st_validate_kheap("extreme:after alloc(0)");

	/* Too-large request should fail cleanly */
	size_t huge = (size_t)-1 / 2;
	void *ph = k_heap_alloc(&st_kheap, huge, K_NO_WAIT);
	st_expect(ph == NULL, "alloc(huge) should return NULL");
	st_validate_kheap("extreme:after alloc(huge)");
}

static void st_fragmentation(void)
{
	k_heap_init(&st_kheap, st_mem, sizeof(st_mem));
	st_validate_kheap("frag:init");

	void *ptrs[16] = {0};
	for (int i = 0; i < 16; i++) {
		ptrs[i] = k_heap_alloc(&st_kheap, 64 + (i * 7), K_NO_WAIT);
		st_expect(ptrs[i] != NULL, "frag alloc returned NULL");
		memset(ptrs[i], (uint8_t)i, 64 + (i * 7));
	}
	st_validate_kheap("frag:after alloc batch");

	for (int i = 0; i < 16; i += 2) {
		k_heap_free(&st_kheap, ptrs[i]);
		ptrs[i] = NULL;
	}
	st_validate_kheap("frag:after freeing evens");

	void *big = k_heap_alloc(&st_kheap, 512, K_NO_WAIT);
	/* big may legitimately fail depending on fragmentation; validate must still hold */
	st_validate_kheap("frag:after big alloc attempt");
	if (big) {
		memset(big, 0xEE, 512);
		k_heap_free(&st_kheap, big);
		st_validate_kheap("frag:after big free");
	}

	for (int i = 0; i < 16; i++) {
		if (ptrs[i]) {
			k_heap_free(&st_kheap, ptrs[i]);
		}
	}
	st_validate_kheap("frag:after cleanup");
}

#ifdef HEAP_SELFTEST_MISUSE
static void st_misuse_expected_crash(void)
{
	/*
	 * Negative/robustness tests (NOT exploitation):
	 * These cases are outside the API contract. With CONFIG_ASSERT=y,
	 * they should typically trap/panic. Without ASSERT, they may corrupt the heap.
	 */

	#ifndef HEAP_SELFTEST_MISUSE_CASE
	#define HEAP_SELFTEST_MISUSE_CASE 1
	#endif

	printk("[SELFTEST_MISUSE] case=%d\n", (int)HEAP_SELFTEST_MISUSE_CASE);

	switch (HEAP_SELFTEST_MISUSE_CASE) {
	case 1: {
		/* double free */
		k_heap_init(&st_kheap, st_mem, sizeof(st_mem));
		void *p = k_heap_alloc(&st_kheap, 32, K_NO_WAIT);
		st_expect(p != NULL, "misuse alloc returned NULL");
		k_heap_free(&st_kheap, p);
		k_heap_free(&st_kheap, p);
		break;
	}
	case 2: {
		/*
		 * cross-heap free (repeated + pseudo-random pointer offsets)
		 *
		 * Goal: make silent corruption more likely/observable in no-ASSERT builds.
		 * We re-init heaps per round to avoid early exhaustion of heap1.
		 */
		st_sentinel_init();

		#ifndef HEAP_SELFTEST_MISUSE_ROUNDS
		#define HEAP_SELFTEST_MISUSE_ROUNDS 200
		#endif
		#ifndef HEAP_SELFTEST_MISUSE_ALLOW_OOB_OFFSET
		#define HEAP_SELFTEST_MISUSE_ALLOW_OOB_OFFSET 1
		#endif

		for (int round = 0; round < HEAP_SELFTEST_MISUSE_ROUNDS; round++) {
			k_heap_init(&st_kheap, st_mem, sizeof(st_mem));
			k_heap_init(&st_kheap2, st_mem2, sizeof(st_mem2));

			/* vary size a bit */
			size_t sz = 16 + (st_prng_next() % 256);
			uint8_t *p = k_heap_alloc(&st_kheap, sz, K_NO_WAIT);
			st_expect(p != NULL, "misuse alloc returned NULL");
			memset(p, 0xA5, sz);

			/* choose offset: sometimes 0, sometimes inside, sometimes beyond */
			size_t mode = st_prng_next() % (HEAP_SELFTEST_MISUSE_ALLOW_OOB_OFFSET ? 3 : 2);
			size_t off;
			if (mode == 0) {
				off = 0;
			} else if (mode == 1) {
				off = 1 + (st_prng_next() % (sz ? sz : 1));
				if (off >= sz) {
					off = sz ? (sz - 1) : 0;
				}
			} else {
				off = 1 + (st_prng_next() % (sz + 64));
			}

			/* Record last parameters for post-mortem debugging. */
			st_last_round = (uint32_t)round;
			st_last_sz = (uint32_t)sz;
			st_last_off = (uint32_t)off;
			st_last_mode = (uint32_t)mode;

			void *q = (void *)(p + off);
			k_heap_free(&st_kheap2, q);

			/* In a non-ASSERT build, corruption often lands in heap2. */
			if (!sys_heap_validate(&st_kheap2.heap)) {
				printk("[SELFTEST_MISUSE] round=%d sz=%u off=%u\n",
				       round, (unsigned)sz, (unsigned)off);
				st_fail("cross-heap/offset free corrupted heap2");
			}

			/* Light stress and global sentinel check for non-heap scribbles. */
			st_heap2_stress();
			if (!st_sentinel_ok()) {
				printk("[SELFTEST_MISUSE] round=%d sz=%u off=%u\n",
				       round, (unsigned)sz, (unsigned)off);
				st_fail("cross-heap/offset free scribbled non-heap memory");
			}
		}
		break;
	}
	case 3: {
		/* interior-pointer free */
		k_heap_init(&st_kheap, st_mem, sizeof(st_mem));
		uint8_t *p = k_heap_alloc(&st_kheap, 64, K_NO_WAIT);
		st_expect(p != NULL, "misuse alloc returned NULL");
		k_heap_free(&st_kheap, p + 1);
		break;
	}
	default:
		st_fail("unknown HEAP_SELFTEST_MISUSE_CASE");
	}

	/* If we got here, ASSERT didn't fire; report what happened. */
	if (!sys_heap_validate(&st_kheap.heap)) {
		st_fail("misuse caused heap corruption (expected in non-ASSERT build)");
	}

	/*
	 * In "observe" mode, do not intentionally crash the system.
	 * This is useful when you want to see whether the misuse leads to
	 * silent corruption (validate failure) vs. apparently surviving.
	 */
	#ifdef HEAP_SELFTEST_MISUSE_OBSERVE
		printk("[SELFTEST_MISUSE] no immediate crash/corruption observed\n");
		return;
	#else
		st_fail("misuse did not crash; check CONFIG_ASSERT/CONFIG_ASSERT_LEVEL");
	#endif
}
#endif

void heap_selftest_run(void)
{
	printk("[SELFTEST] start\n");

	st_basic_alloc_free();
	st_realloc_semantics();
	st_aligned_alloc();
	st_extreme_sizes();
	st_fragmentation();

#ifdef HEAP_SELFTEST_MISUSE
	st_misuse_expected_crash();
#endif

	printk("[SELFTEST_PASS]\n");
}
```

## src/main-zwzz.c
```c
/*
 * Zephyr k_heap 强化版模糊测试 Harness
 * 优化重点：内存染色、对齐验证、完整性校验、多 API 覆盖
 */

#include <zephyr/kernel.h>
#include <zephyr/sys/printk.h>
#include <zephyr/sys/math_extras.h>
#include <zephyr/sys/sys_heap.h>
#include <zephyr/sys/util.h>
#include <string.h>
#include <stdint.h>

// --- LibAFL 配置 ---
#define MAX_FUZZ_INPUT_SIZE 1024
__attribute__((used, visibility("default"))) 
__attribute__((used)) unsigned char FUZZ_INPUT[MAX_FUZZ_INPUT_SIZE] = {
    // Offset 00000000
    0x90, 0xa0, 0xb0, 0x7f, 0x5f, 0x70, 0x7f, 0x8f, 
    0xe1, 0xbe, 0x46, 0x55, 0x5a, 0x5a, 0x01, 0x23,
    // Offset 00000010
    0x45, 0x70, 0x80, 0x90, 0xdf, 0x30, 0x40, 0x50, 
    0x60, 0x70, 0x80, 0x40, 0xe7
};// 初始种子

/*
 * Ensure FUZZ_INPUT is retained in the final image even when building
 * in non-fuzz modes (e.g., HEAP_SELFTEST_ONLY) where it might otherwise
 * be removed by aggressive GC/LTO.
 */
static volatile uintptr_t fuzz_input_anchor;

// --- 测试配置 ---
#define MAX_ALLOCS 12      // 增加指针池大小以提升碎片化复杂度
#define HEAP_SIZE 4096     // 扩大堆空间
#define MIN_ALIGN 4
#define MAX_ALIGN 64

static uint8_t heap_mem[HEAP_SIZE] __aligned(64);
static struct k_heap my_heap;

// 记录分配信息的结构体，用于检测 OOB (越界)
struct alloc_info {
    void *ptr;
    size_t size;
    uint8_t magic; // 用于校验内存内容的幻数
};

static struct alloc_info slots[MAX_ALLOCS];

static inline void validate_heap_or_trap(void)
{
    if (!sys_heap_validate(&my_heap.heap)) {
        printk("FATAL: sys_heap_validate failed\n");
        __builtin_trap();
    }
}

// --- 基础辅助工具 (FR_Reader) ---
typedef struct {
    const unsigned char* data;
    size_t size;
    size_t off;
} FR_Reader;

static inline FR_Reader FR_init(const unsigned char* buf, size_t n) {
    return (FR_Reader){ buf, n, 0 };
}

static inline uint8_t FR_next_u8(FR_Reader* r) {
    return (r->off < r->size) ? r->data[r->off++] : 0;
}

static inline uint32_t FR_next_u32(FR_Reader* r) {
    uint32_t v = 0;
    for (int i = 0; i < 4; i++) v |= ((uint32_t)FR_next_u8(r) << (i * 8));
    return v;
}

static inline uint32_t FR_next_range(FR_Reader* r, uint32_t min, uint32_t max) {
    if (max <= min) return min;
    return min + (FR_next_u32(r) % (max - min + 1));
}

// --- 强化功能函数 ---

// 1. 内存填充：向分配的块写入特定模式，用于检测非法篡改
static void scribble_memory(struct alloc_info *info) {
    if (info->ptr && info->size > 0) {
        memset(info->ptr, info->magic, info->size);
    }
}

// 2. 内存校验：释放前检查内容是否被意外修改
static void verify_memory(struct alloc_info *info) {
    if (!info->ptr) return;
    uint8_t *p = (uint8_t *)info->ptr;
    for (size_t i = 0; i < info->size; i++) {
        if (p[i] != info->magic) {
            printk("FATAL: Memory corruption detected at %p (offset %zu)\n", p, i);
            __builtin_trap(); // 强制触发 Fuzzer 崩溃捕获
        }
    }
}

// 3. 停机指令
int __attribute__((noinline)) BREAKPOINT(void) {
    for (;;) { __asm__ volatile("nop"); }
}

// --- 核心测试函数 ---
void test_once(const uint8_t *input, size_t len) {
    FR_Reader r = FR_init(input, len);
    
    // 重置状态
    k_heap_init(&my_heap, heap_mem, HEAP_SIZE);
    memset(slots, 0, sizeof(slots));
    validate_heap_or_trap();

    // 从输入决定执行多少步操作 (10-50步)
    uint32_t steps = FR_next_range(&r, 10, 50);

    for (uint32_t i = 0; i < steps; i++) {
        uint8_t action = FR_next_u8(&r) % 6; // 六种动作
        uint8_t slot_idx = FR_next_u8(&r) % MAX_ALLOCS;
        struct alloc_info *slot = &slots[slot_idx];

        switch (action) {
            case 0: // 常规分配 (k_heap_alloc)
                if (!slot->ptr) {
                    slot->size = (size_t)FR_next_range(&r, 1, 512);
                    slot->magic = FR_next_u8(&r);
                    slot->ptr = k_heap_alloc(&my_heap, slot->size, K_NO_WAIT);
                    scribble_memory(slot);
                    validate_heap_or_trap();
                }
                break;

            case 1: // 对齐分配 (k_heap_aligned_alloc)
                if (!slot->ptr) {
                    // 随机对齐量：4, 8, 16, 32, 64
                    size_t align = 1 << FR_next_range(&r, 2, 6); 
                    slot->size = (size_t)FR_next_range(&r, 1, 512);
                    slot->magic = FR_next_u8(&r);
                    slot->ptr = k_heap_aligned_alloc(&my_heap, align, slot->size, K_NO_WAIT);
                    
                    // 验证对齐是否生效
                    if (slot->ptr && ((uintptr_t)slot->ptr % align != 0)) {
                        printk("FATAL: Alignment error! ptr=%p, align=%zu\n", slot->ptr, align);
                        __builtin_trap();
                    }
                    scribble_memory(slot);
                    validate_heap_or_trap();
                }
                break;

            case 2: // 释放内存 (k_heap_free)
                if (slot->ptr) {
                    verify_memory(slot); // 释放前校验，捕获静默越界
                    k_heap_free(&my_heap, slot->ptr);
                    slot->ptr = NULL;
                    validate_heap_or_trap();
                }
                break;

            case 3: // 模拟“使用中”读取
                if (slot->ptr) {
                    verify_memory(slot);
                }
                break;

            case 4: // 重新分配 (k_heap_realloc)
                if (slot->ptr) {
                    verify_memory(slot);
                    size_t new_size = (size_t)FR_next_range(&r, 0, 768);
                    void *p2 = k_heap_realloc(&my_heap, slot->ptr, new_size, K_NO_WAIT);
                    if (new_size == 0) {
                        /* realloc(ptr,0) frees and returns NULL */
                        if (p2 != NULL) {
                            printk("FATAL: realloc(ptr,0) returned non-NULL\n");
                            __builtin_trap();
                        }
                        slot->ptr = NULL;
                        slot->size = 0;
                    } else if (p2 != NULL) {
                        slot->ptr = p2;
                        slot->size = new_size;
                        scribble_memory(slot);
                    } else {
                        /* realloc failed: original pointer remains valid */
                        verify_memory(slot);
                    }
                    validate_heap_or_trap();
                }
                break;

            case 5: // calloc (k_heap_calloc)
                if (!slot->ptr) {
                    size_t n = (size_t)FR_next_range(&r, 1, 64);
                    size_t sz = (size_t)FR_next_range(&r, 1, 64);
                    size_t total;
                    if (size_mul_overflow(n, sz, &total) || total == 0 || total > 512) {
                        break;
                    }

                    void *p = k_heap_calloc(&my_heap, n, sz, K_NO_WAIT);
                    if (p != NULL) {
                        /* Verify calloc semantics for requested bytes only */
                        uint8_t *b = (uint8_t *)p;
                        for (size_t j = 0; j < total; j++) {
                            if (b[j] != 0) {
                                printk("FATAL: calloc not zeroed (offset %zu)\n", j);
                                __builtin_trap();
                            }
                        }

                        slot->ptr = p;
                        slot->size = total;
                        slot->magic = FR_next_u8(&r);
                        scribble_memory(slot);
                        validate_heap_or_trap();
                    }
                }
                break;
        }
    }

    // 清理：释放所有遗留内存，防止干扰下一轮测试
    for (int i = 0; i < MAX_ALLOCS; i++) {
        if (slots[i].ptr) {
            verify_memory(&slots[i]);
            k_heap_free(&my_heap, slots[i].ptr);
        }
    }

    validate_heap_or_trap();
    
    printk("[TEST_CASE_COMPLETED]\n");
}

int main(void) {
    /* Keep a runtime reference to FUZZ_INPUT for external runners. */
    fuzz_input_anchor = (uintptr_t)FUZZ_INPUT;
#ifdef HEAP_SELFTEST_ONLY
    extern void heap_selftest_run(void);
    heap_selftest_run();
    printk("[SELFTEST_DONE]\n");
    k_msleep(1);
    BREAKPOINT();
    return 0;
#else
    test_once(FUZZ_INPUT, MAX_FUZZ_INPUT_SIZE);
    k_msleep(1);
    BREAKPOINT();
    return 0;
#endif
}
```

## src/main1.c
```c
/*
 * Zephyr fuzz reproduction harness
 * Crash Input: 0c4aae4321fe8974 (Reproduction Mode)
 * Status: Fixed Reader Logic & Enabled Padding Check
 */

#include <zephyr/kernel.h>
#include <zephyr/sys/printk.h>
#include <zephyr/sys/sys_heap.h>
#include <string.h>
#include <stdint.h>
#include <stddef.h>

// LibAFL integration: deterministic global input buffer
#define MAX_FUZZ_INPUT_SIZE 1024

// 已填入你的 Crash Data (72 bytes)
__attribute__((used, visibility("default"))) unsigned char FUZZ_INPUT[MAX_FUZZ_INPUT_SIZE] = {
    // 00000000
    0xd3, 0x2d, 0xff, 0xbb, 0xbc, 0x45, 0xd3, 0xd3, 0x01, 0x00, 0xed, 0x10, 0xed, 0x6d, 0xed, 0xed,
    // 00000010
    0x14, 0x14, 0x14, 0x14, 0x14, 0x14, 0x14, 0xc5, 0xc5, 0xc5, 0xc5, 0xc5, 0xc5, 0xff, 0xed, 0xed,
    // 00000020
    0xff, 0xed, 0x10, 0xed, 0xff, 0xed, 0x10, 0xed, 0x6d, 0xed, 0x10, 0x0d, 0xed, 0xff, 0x13, 0x10,
    // 00000030
    0xed, 0xff, 0x06, 0x06, 0x06, 0x06, 0x06, 0x06, 0x06, 0x06, 0x06, 0x06, 0x06, 0x06, 0xd3, 0xde,
    // 00000040
    0xd3, 0xd3, 0x4f, 0xa5, 0xd3, 0x4f, 0xed, 0xed
};

int __attribute__((noinline, used, visibility("default"))) BREAKPOINT(void)
{
    for (;;) {
        __asm volatile("nop");
    }
}

typedef struct {
    const unsigned char* data;
    size_t size;
    size_t off;
} FR_Reader;

static inline FR_Reader FR_init(const unsigned char* buf, size_t n)
{
    FR_Reader r = { buf, n, 0 };
    return r;
}

static inline size_t FR_remaining(FR_Reader* r)
{
    return (r->off < r->size) ? (r->size - r->off) : 0;
}

static inline uint8_t FR_next_u8(FR_Reader* r)
{
    if (r->off + 1 <= r->size) {
        return r->data[r->off++];
    }
    return 0;
}

static inline uint16_t FR_next_u16(FR_Reader* r)
{
    uint16_t lo = FR_next_u8(r);
    uint16_t hi = FR_next_u8(r);
    return (uint16_t)((hi << 8) | lo);
}

static inline uint32_t FR_next_u32(FR_Reader* r)
{
    uint32_t lo = FR_next_u16(r);
    uint32_t hi = FR_next_u16(r);
    return (hi << 16) | lo;
}

static inline int32_t FR_next_s32(FR_Reader* r)
{
    return (int32_t)FR_next_u32(r);
}

static inline uint32_t FR_next_range(FR_Reader* r, uint32_t min_v, uint32_t max_v)
{
    if (max_v <= min_v) {
        return min_v;
    }
    uint32_t span = max_v - min_v + 1u;
    return min_v + (FR_next_u32(r) % span);
}

static inline size_t FR_next_bytes(FR_Reader* r, unsigned char* out, size_t n)
{
    size_t rem = FR_remaining(r);
    if (n > rem) {
        n = rem;
    }
    if (n) {
        memcpy(out, r->data + r->off, n);
        r->off += n;
    }
    return n;
}

// -------------------------------------------------------------

#define MAX_ALLOCS 8
#define HEAP_SIZE 2048

#define PAD_WORDS 1024
#define PAD_PRE_PATTERN  0xA5A5A5A5u
#define PAD_POST_PATTERN 0x5A5A5A5Au

// 【重要】恢复 Padding 布局，以便用 GDB 证明是“隔空打击”
struct safe_heap_layout {
    volatile uint32_t padding_pre[PAD_WORDS];  // 4KB 前置装甲
    uint8_t heap_mem[HEAP_SIZE];          // 核心堆内存
    volatile uint32_t padding_post[PAD_WORDS]; // 4KB 后置装甲
} __attribute__((aligned(8)));

static struct safe_heap_layout my_layout;
static struct k_heap my_heap;
static void *ptrs[MAX_ALLOCS];

static inline void die_now(void)
{
    /* Crash/stop fast for the fuzzer. */
    k_panic();
}

static void padding_init(void)
{
    for (size_t i = 0; i < PAD_WORDS; ++i) {
        my_layout.padding_pre[i] = PAD_PRE_PATTERN;
        my_layout.padding_post[i] = PAD_POST_PATTERN;
    }
}

static bool padding_ok(void)
{
    /* Full scan is fine for debugging; tighten later if needed. */
    for (size_t i = 0; i < PAD_WORDS; ++i) {
        if (my_layout.padding_pre[i] != PAD_PRE_PATTERN) {
            return false;
        }
        if (my_layout.padding_post[i] != PAD_POST_PATTERN) {
            return false;
        }
    }
    return true;
}

static inline bool heap_ok(void)
{
    return sys_heap_validate(&my_heap.heap);
}

static inline bool ptr_in_heap(void *p)
{
    uintptr_t addr = (uintptr_t)p;
    uintptr_t start = (uintptr_t)my_layout.heap_mem;
    uintptr_t end = start + (uintptr_t)HEAP_SIZE;
    return (addr >= start) && (addr < end);
}

static void check_invariants_or_die(const char *where)
{
    if (!padding_ok()) {
        printk("[BUG] padding corrupted at %s\n", where);
        die_now();
    }
    if (!heap_ok()) {
        printk("[BUG] heap validation failed at %s\n", where);
        die_now();
    }
}

static inline size_t min_size(size_t a, size_t b)
{
    return (a < b) ? a : b;
}

static inline bool mul_overflow_size(size_t a, size_t b, size_t *out)
{
    if (a == 0 || b == 0) {
        *out = 0;
        return false;
    }
    if (a > (SIZE_MAX / b)) {
        return true;
    }
    *out = a * b;
    return false;
}

static void test_once(void)
{
    /*
     * Per-execution harness:
     * - Always re-init heap and padding to avoid cross-run state.
     * - Validate heap and guard bands aggressively to pinpoint first corruption.
     */
    padding_init();
    k_heap_init(&my_heap, my_layout.heap_mem, HEAP_SIZE);
    for (int j = 0; j < MAX_ALLOCS; j++) {
        ptrs[j] = NULL;
    }
    check_invariants_or_die("init");

    FR_Reader reader = FR_init(FUZZ_INPUT, MAX_FUZZ_INPUT_SIZE);

    /* Consume a small baseline/prefix to decorrelate from fixed headers. */
    unsigned char baseline[8] = {0};
    (void)FR_next_bytes(&reader, baseline, sizeof(baseline));

    /* Steps per input. Allow enough operations to trigger fragmentation bugs. */
    uint32_t steps = FR_next_range(&reader, 1, 256);

    for (uint32_t i = 0; i < steps; ++i) {
        if (FR_remaining(&reader) < 8) {
            break;
        }

        uint32_t action = FR_next_range(&reader, 0, 2);
        uint32_t slot = FR_next_range(&reader, 0, MAX_ALLOCS - 1);

        if (action == 0) {
            /* alloc */
            if (FR_remaining(&reader) < 4) {
                break;
            }
            size_t sz = (size_t)FR_next_range(&reader, 1, HEAP_SIZE);
            if (ptrs[slot] == NULL) {
                void *p = k_heap_alloc(&my_heap, sz, K_NO_WAIT);
                if (p != NULL) {
                    if (!ptr_in_heap(p)) {
                        printk("[BUG] alloc returned non-heap ptr %p\n", p);
                        die_now();
                    }
                    /* Touch a few bytes to exercise the allocated region safely. */
                    size_t usable = sys_heap_usable_size(&my_heap.heap, p);
                    size_t touch = min_size(usable, 16);
                    memset(p, 0xA5, touch);
                    ptrs[slot] = p;
                }
            }
            check_invariants_or_die("alloc");
        } else if (action == 1) {
            /* calloc */
            if (FR_remaining(&reader) < 8) {
                break;
            }
            size_t n = (size_t)FR_next_range(&reader, 1, 32);
            size_t s = (size_t)FR_next_range(&reader, 1, 256);
            if (ptrs[slot] == NULL) {
                void *p = k_heap_calloc(&my_heap, n, s, K_NO_WAIT);
                if (p != NULL) {
                    if (!ptr_in_heap(p)) {
                        printk("[BUG] calloc returned non-heap ptr %p\n", p);
                        die_now();
                    }
                    /*
                     * calloc() guarantees zeroing of the requested n*s bytes,
                     * not necessarily the whole allocator-usable size.
                     */
                    size_t requested = 0;
                    if (mul_overflow_size(n, s, &requested)) {
                        printk("[BUG] calloc size overflow (n=%u s=%u)\n", (unsigned)n, (unsigned)s);
                        die_now();
                    }
                    size_t usable = sys_heap_usable_size(&my_heap.heap, p);
                    size_t touch = min_size(min_size(requested, usable), 16);
                    for (size_t k = 0; k < touch; ++k) {
                        if (((uint8_t *)p)[k] != 0) {
                            printk("[BUG] calloc not zeroed (%p[%u]=%u, req=%u usable=%u)\n",
                                   p, (unsigned)k, ((uint8_t *)p)[k], (unsigned)requested, (unsigned)usable);
                            die_now();
                        }
                    }
                    ptrs[slot] = p;
                }
            }
            check_invariants_or_die("calloc");
        } else {
            /* free */
            if (ptrs[slot] != NULL) {
                void *p = ptrs[slot];
                if (!ptr_in_heap(p)) {
                    printk("[BUG] freeing non-heap ptr %p\n", p);
                    die_now();
                }
                k_heap_free(&my_heap, p);
                ptrs[slot] = NULL;
            }
            check_invariants_or_die("free");
        }
    }

    /* Cleanup */
    for (int j = 0; j < MAX_ALLOCS; j++) {
        if (ptrs[j] != NULL) {
            k_heap_free(&my_heap, ptrs[j]);
            ptrs[j] = NULL;
        }
    }
    check_invariants_or_die("cleanup");
}

int main(void)
{
    test_once();

    /* Mark completion for runners that look for it. */
    printk("[TEST_CASE_COMPLETED]\n");

    k_msleep(1);
    BREAKPOINT();
    return 0;
}
```

## src/none_pointer.c
```c
#include <stdio.h>
#include <string.h>
#include <zephyr/kernel.h>
#include <zephyr/sys/printk.h>

#ifdef TARGET_CUSTOM_INSN
#include "lqemu.h"
#endif

#ifndef TARGET_CUSTOM_INSN
int __attribute__((noinline)) BREAKPOINT() {
    for (;;) {}
}
#endif

// 空指针解引用漏洞
void null_pointer_dereference_vulnerability(unsigned int *data, unsigned int size) {
    printf("Null pointer test\n");
    
    int *ptr = NULL;
    int safe_value = 1234;
    
    printf("Safe value before: %d\n", safe_value);
    
    if (size > 0 && data[0] == 0) {
        printf("Triggering null pointer dereference\n");
        
        // 直接解引用空指针 - 肯定崩溃
        *ptr = 42;
    } else if (size > 0) {
        int value = data[0];
        ptr = &value;
        *ptr = 100;
        printf("Safe pointer usage: %d\n", *ptr);
    }
    
    printf("Safe value after: %d\n", safe_value);
}

int LLVMFuzzerTestOneInput(unsigned int *Data, unsigned int Size) {
#ifdef TARGET_CUSTOM_INSN
    libafl_qemu_start_phys((void *)Data, Size);
#endif

    printf("=== Null Pointer Dereference Test ===\n");
    
    if (Size > 0) {
        null_pointer_dereference_vulnerability(Data, Size);
    }

    printf("Test completed!\n");

#ifdef TARGET_CUSTOM_INSN
    libafl_qemu_end(LIBAFL_QEMU_END_OK);
#else
    return BREAKPOINT();
#endif
}

unsigned int FUZZ_INPUT[] = {0};  // 输入0触发空指针解引用

int main(void) {
    printf("Starting null pointer test\n");
    LLVMFuzzerTestOneInput(FUZZ_INPUT, 1);
    return 0;
}
```
